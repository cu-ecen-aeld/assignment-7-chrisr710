## base_external/Config.in
```kconfig
source "$BR2_EXTERNAL_project_base_PATH/package/scull/Config.in"
source "$BR2_EXTERNAL_project_base_PATH/package/misc_modules/Config.in"
```

## base_external/package/ldd/Config.in
```kconfig
config BR2_PACKAGE_LDD
	bool "LDD"
	help
	  INCLUDES THE LDD STUFF FOR ASSIGNMENT 7.
	  Used to understand buildroot external trees and package builds.
```
